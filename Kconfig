## Kconfig
```kconfig
# Copyright (c) 2025, Centro de Inovação Edge.
# SPDX-License-Identifier: BSD-3-Clause

menuconfig OLED_FONTS
    bool "OLED Fonts"

if OLED_FONTS
    config OLED_FONT_5x7
        bool "ASCII 5x7px default font."
        default y

    config OLED_FONT_7x10
        bool "ASCII 7x10px default font."
        default y
endif
```

## fonts/Kconfig
```kconfig
config OLED_FONT_5x7
    bool "ASCII 5x7px default font."
    default y

config OLED_FONT_7x10
    bool "ASCII 7x10px default font."
    default y
```
